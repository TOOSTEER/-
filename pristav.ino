#include <AnalogKey.h>
#include <GyverButton.h>
#include <charMap.h>
#include <GyverOLED.h>
#include <icons_7x7.h>
#include <icons_8x8.h>
GyverOLED<SSD1306_128x64, OLED_NO_BUFFER> oled;
#define up 5
#define down 3
#define ok 6
#define rightt 9
#define leftt 10
#define PIEZO_PIN 11
void setup() {
  Serial.begin(9600);
  pinMode(up, INPUT_PULLUP);
  pinMode(down, INPUT_PULLUP);
  pinMode(ok, INPUT_PULLUP);
  pinMode(leftt, INPUT_PULLUP);
  pinMode(rightt, INPUT_PULLUP);
  oled.setContrast(255);
  oled.init();
  oled.clear();
  oled.setScale(1.5);
}
void loop() {
  unsigned long timing_run = millis();
  unsigned long timing_const = 0;
  bool UP = digitalRead(up);
  bool DOWN = digitalRead(down);
  bool OK = digitalRead(ok);
  bool LEFT = digitalRead(leftt);
  bool RIGHT = digitalRead(rightt);
  static uint8_t pointer = 0;
  if (OK == 1) {
    tone (PIEZO_PIN, 700, 300);
    delay(500);
    switch (pointer) {
      case 0: Game_1(); break;
      case 1: Game_2(); break;
      case 2: Game_3(); break;
      case 3: Game_4(); break;
    }
  }
  if (LEFT == 1) {
    tone (PIEZO_PIN, 500, 300);
    delay(500);
  }
  if (RIGHT == 1) {
    tone (PIEZO_PIN, 500, 300);
    delay(500);
  }
  if (UP == 1) {
    pointer = constrain(pointer - 2, 0, 6);
    oled.clear();
    tone (PIEZO_PIN, 500, 300);
    delay(500);
  }
  if (DOWN == 1) {
    pointer = constrain(pointer + 2, 0, 6);
    oled.clear();
    tone(PIEZO_PIN, 500, 300);
    delay(500);
  }
  oled.setCursor(10, 0);
  oled.print("Game 1:  Змейка ");
  oled.setCursor(10, 2);
  oled.print("Game 2:  Название");
  oled.setCursor(10, 4);
  oled.print("Game 3:  Название");
  oled.setCursor(10, 6);
  oled.print("Game 4:  Название");
  oled.setCursor(0, 0);
  print_Pointer(pointer);
  delay(1000);
}
void print_Pointer(uint8_t ptr) {
  oled.setCursor(0, ptr);
  oled.print(">");
}
void Game_1 () {
  const uint8_t rook_bitmap PROGMEM = {
    0xff, 0xfe, 0x0c, 0xfe, 0x7c, 0x3c, 0x7f, 0xff, 0xff, 0xfe, 0x0c, 0xfe, 0x7c, 0x3c, 0x7f, 0xff,
    0xe0, 0x06, 0x3f, 0xf8, 0x67, 0x30, 0x60, 0x07, 0xc0, 0x06, 0x3f, 0xf8, 0x67, 0x30, 0x60, 0x03,
    0xcf, 0xe6, 0x00, 0x39, 0xe0, 0x30, 0x67, 0xf3, 0xcf, 0xe6, 0x00, 0x39, 0xe0, 0x30, 0x67, 0xf3,
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    0xff, 0xfe, 0x0f, 0x3e, 0x60, 0x33, 0xfe, 0x00, 0xff, 0xfe, 0x0f, 0x3e, 0x60, 0x33, 0xfe, 0x00
  };
  oled.clear();
  oled.print(rook_bitmap);
  oled.update();
  while (1) {
    if (digitalRead(ok) == 1) return;
  }
}
void Game_2 () {
  oled.clear();
  oled.setCursor(35, 3);
  oled.print("Извините");
  oled.setCursor(25, 5);
  oled.print("Ещё не готово");
  oled.update();
  while (1) {
    if (digitalRead(ok) == 1) return;
  }
}

void Game_3 () {
  oled.clear();
  oled.setCursor(35, 3);
  oled.print("Извините");
  oled.setCursor(25, 5);
  oled.print("Ещё не готово");
  oled.update();
  while (1) {
    if (digitalRead(ok) == 1) return;
  }
}
void Game_4 () {
  oled.clear();
  oled.setCursor(35, 3);
  oled.print("Извините");
  oled.setCursor(25, 5);
  oled.print("Ещё не готово");
  oled.update();
  while (1) {
    if (digitalRead(ok) == 1) return;
  }
}
